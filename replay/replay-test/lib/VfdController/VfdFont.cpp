#include "VfdFont.h"
#include <string.h>

// Font data below is 7x5 grids, ALREADY flipped to match the confirmed
// VFD hardware row order (see VfdController.cpp encodeSegment / the
// reverse-engineering notes in VfdController.h). Adapted from Adafruit_GFX's
// glcdfont.c (MIT licensed, https://github.com/adafruit/Adafruit-GFX-Library).

// Printable ASCII 32 (space) through 126 (~), 95 glyphs.
static const uint8_t FONT_ASCII[95][7][5] PROGMEM = {
  {{0,0,0,0,0}, {0,0,0,0,0}, {0,0,0,0,0}, {0,0,0,0,0}, {0,0,0,0,0}, {0,0,0,0,0}, {0,0,0,0,0}}, // ' ' (0x20)
  {{0,0,1,0,0}, {0,0,0,0,0}, {0,0,1,0,0}, {0,0,1,0,0}, {0,0,1,0,0}, {0,0,1,0,0}, {0,0,1,0,0}}, // '!' (0x21)
  {{0,0,0,0,0}, {0,0,0,0,0}, {0,0,0,0,0}, {0,0,0,0,0}, {0,1,0,1,0}, {0,1,0,1,0}, {0,1,0,1,0}}, // '"' (0x22)
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  {{0,0,0,0,0}, {0,0,0,0,0}, {0,0,0,0,0}, {0,0,0,0,0}, {0,0,0,1,0}, {1,0,1,0,1}, {0,1,0,0,0}}, // '~' (0x7E)
};

// A handful of Latin-1 extras for German text: ae/oe/ue umlauts + sharp-s.
// Not contiguous with the ASCII range, so looked up by explicit codepoint.
struct ExtraGlyph {
  uint32_t codepoint;
  uint8_t grid[7][5];
};

static const ExtraGlyph FONT_EXTRAS[] PROGMEM = {
  {0x00FC, {{0,1,1,0,1}, {1,0,0,1,1}, {1,0,0,0,1}, {1,0,0,0,1}, {0,0,0,0,0}, {1,0,0,0,1}, {0,0,0,0,0}}}, // u umlaut (ü)
  {0x00E4, {{0,1,1,1,1}, {1,0,0,1,0}, {0,1,1,1,0}, {0,0,0,1,0}, {0,1,1,0,0}, {1,0,0,0,1}, {0,0,0,0,0}}}, // a umlaut (ä)
  {0x00F6, {{0,1,1,1,0}, {1,0,0,0,1}, {1,0,0,0,1}, {1,0,0,0,1}, {0,1,1,1,0}, {1,0,0,0,1}, {0,0,0,0,0}}}, // o umlaut (ö)
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  {0x266A, {{1,1,0,0,0}, {1,1,1,0,0}, {0,1,1,0,0}, {0,0,1,0,0}, {0,0,1,0,1}, {0,0,1,1,0}, {0,0,1,0,0}}} // note (♪)
};
static const size_t FONT_EXTRAS_LEN = 8;

void vfdGetGlyph(uint32_t codepoint, uint8_t outGrid[7][5]) {
  if (codepoint >= 32 && codepoint <= 126) {
    const uint8_t (*glyph)[5] = FONT_ASCII[codepoint - 32];
    for (int r = 0; r < 7; r++) {
      for (int c = 0; c < 5; c++) {
        outGrid[r][c] = pgm_read_byte(&glyph[r][c]);
      }
    }
    return;
  }

  for (size_t i = 0; i < FONT_EXTRAS_LEN; i++) {
    uint32_t cp = pgm_read_dword(&FONT_EXTRAS[i].codepoint);
    if (cp == codepoint) {
      for (int r = 0; r < 7; r++) {
        for (int c = 0; c < 5; c++) {
          outGrid[r][c] = pgm_read_byte(&FONT_EXTRAS[i].grid[r][c]);
        }
      }
      return;
    }
  }

  // Unsupported codepoint: render blank.
  memset(outGrid, 0, 7 * 5);
}

uint32_t vfdUtf8Decode(const char **text) {
  const uint8_t *p = (const uint8_t *)(*text);
  uint8_t b0 = p[0];

  if (b0 < 0x80) {
    *text += 1;
    return b0;
  }
  if ((b0 & 0xE0) == 0xC0 && p[1] != 0) {
    uint32_t cp = ((b0 & 0x1F) << 6) | (p[1] & 0x3F);
    *text += 2;
    return cp;
  }
  if ((b0 & 0xF0) == 0xE0 && p[1] != 0 && p[2] != 0) {
    uint32_t cp = ((b0 & 0x0F) << 12) | ((p[1] & 0x3F) << 6) | (p[2] & 0x3F);
    *text += 3;
    return cp;
  }
  if ((b0 & 0xF8) == 0xF0 && p[1] != 0 && p[2] != 0 && p[3] != 0) {
    uint32_t cp = ((b0 & 0x07) << 18) | ((p[1] & 0x3F) << 12) | ((p[2] & 0x3F) << 6) | (p[3] & 0x3F);
    *text += 4;
    return cp;
  }

  // Invalid or truncated sequence: consume one byte so callers always
  // make progress, return it raw (will render blank via vfdGetGlyph).
  *text += 1;
  return b0;
}